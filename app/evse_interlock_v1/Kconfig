## app/evse_interlock_v1/Kconfig
```kconfig
#
# Copyright (c) 2022 Nordic Semiconductor ASA
#
# SPDX-License-Identifier: LicenseRef-Nordic-5-Clause
#

mainmenu "Sidewalk End Device nRF Connect Application"

choice SID_END_DEVICE
	prompt "Select application variant to run"
    default SID_END_DEVICE_HELLO
config SID_END_DEVICE_HELLO
    bool "Sidewalk hello world application"
endchoice #SID_END_DEVICE

if SID_END_DEVICE_HELLO

config SID_END_DEVICE_ECHO_MSGS
    bool "Eable message echo feature"
    default y
    help
      Echo received messages back to Sidewlak cloud.
      Works with GET and SET messages types.

config SID_END_DEVICE_GPIO_EVENTS
    bool "Enable GPIO change events"
    default y
    help
      Sends a Sidewalk uplink when a GPIO input changes.

config SID_END_DEVICE_GPIO_DEBOUNCE_MS
    int "GPIO debounce time (ms)"
    default 50
    help
      Minimum time a new GPIO state must be stable before reporting.

config SID_END_DEVICE_GPIO_POLL_INTERVAL_MS
    int "GPIO polling interval (ms)"
    default 100
    help
      Polling interval when interrupts are unavailable.

config SID_END_DEVICE_GPIO_SIMULATOR
    bool "Enable GPIO input simulator"
    default y
    depends on SID_END_DEVICE_GPIO_EVENTS
    help
      Simulate a GPIO input change on a timer. Disable this when wiring
      a real input to the hvac alias.

config SID_END_DEVICE_EVSE_ENABLED
    bool "Enable EVSE (J1772) sensing"
    default y
    depends on GPIO && ADC
    help
      Enables pilot voltage, PWM duty cycle, proximity, and current sensing.

config SID_END_DEVICE_EVSE_SAMPLE_INTERVAL_MS
    int "EVSE sample interval (ms)"
    default 2000
    help
      Polling interval for pilot/current/proximity updates.

config SID_END_DEVICE_EVSE_PWM_GPIO_PORT
    int "EVSE PWM GPIO port (0 or 1)"
    default 0
    help
      GPIO port for pilot PWM input.

config SID_END_DEVICE_EVSE_PWM_GPIO_PIN
    int "EVSE PWM GPIO pin"
    default 1
    help
      GPIO pin for pilot PWM input capture.

config SID_END_DEVICE_EVSE_PROX_GPIO_PORT
    int "EVSE proximity GPIO port (0 or 1)"
    default 0
    help
      GPIO port for proximity detect input.

config SID_END_DEVICE_EVSE_PROX_GPIO_PIN
    int "EVSE proximity GPIO pin"
    default 4
    help
      GPIO pin for proximity detect input.

config SID_END_DEVICE_EVSE_PILOT_ADC_CHANNEL
    int "EVSE pilot ADC channel"
    default 2
    help
      ADC channel for pilot voltage measurement.

config SID_END_DEVICE_EVSE_CURRENT_ADC_CHANNEL
    int "EVSE current ADC channel"
    default 3
    help
      ADC channel for current sensor input.

config SID_END_DEVICE_EVSE_PILOT_SCALE_NUM
    int "Pilot voltage scale numerator"
    default 1
    help
      Multiplier applied to pilot ADC mV reading.

config SID_END_DEVICE_EVSE_PILOT_SCALE_DEN
    int "Pilot voltage scale denominator"
    default 1
    help
      Divider applied to pilot ADC mV reading.

config SID_END_DEVICE_EVSE_PILOT_BIAS_MV
    int "Pilot voltage bias (mV)"
    default 0
    help
      Bias to subtract for recovering negative pilot voltages.

config SID_END_DEVICE_EVSE_CURRENT_SCALE_NUM
    int "Current scale numerator (mA per mV)"
    default 1
    help
      Multiplier applied to current ADC mV reading.

config SID_END_DEVICE_EVSE_CURRENT_SCALE_DEN
    int "Current scale denominator (mA per mV)"
    default 1
    help
      Divider applied to current ADC mV reading.

config SID_END_DEVICE_EVSE_NOMINAL_VOLTAGE_V
    int "Nominal line voltage (V)"
    default 240
    help
      Used for kWh estimation (current * voltage).

config SID_END_DEVICE_EVSE_PILOT_TOLERANCE_MV
    int "Pilot state tolerance (mV)"
    default 1000
    help
      Tolerance applied to pilot voltage state mapping.

config SID_END_DEVICE_LINE_CURRENT_ENABLED
    bool "Enable Line Current Monitor"
    default y
    depends on ADC
    help
      Enables external current clamp monitoring upstream of EVSE.

config SID_END_DEVICE_LINE_CURRENT_SAMPLE_INTERVAL_MS
    int "Line current sample interval (ms)"
    default 2000
    help
      Polling interval for line current measurements.

config SID_END_DEVICE_LINE_CURRENT_ADC_CHANNEL
    int "Line current ADC channel"
    default 4
    help
      ADC channel for line current clamp input.

config SID_END_DEVICE_LINE_CURRENT_SCALE_NUM
    int "Line current scale numerator (mA per mV)"
    default 1
    help
      Multiplier applied to line current ADC mV reading.

config SID_END_DEVICE_LINE_CURRENT_SCALE_DEN
    int "Line current scale denominator (mA per mV)"
    default 1
    help
      Divider applied to line current ADC mV reading.

config SID_END_DEVICE_LINE_CURRENT_DELTA_MA
    int "Line current change threshold (mA)"
    default 1000
    help
      Minimum delta between samples to emit a current_change event.

config SID_END_DEVICE_DEVICE_ID
    string "Device ID for telemetry payloads"
    default "unknown"
    help
      Identifier included in outbound telemetry JSON.

config SID_END_DEVICE_DEVICE_TYPE
    string "Device type for telemetry payloads"
    default "evse"
    help
      Device type included in outbound telemetry JSON.

endif #SID_END_DEVICE_HELLO

config SID_END_DEVICE_AUTO_START
    default y
    bool "Enable automatic Sidewalk initlization and start"

config SID_END_DEVICE_AUTO_CONN_REQ
    default y
    bool "Enable automatic connection request before message send"

config SID_END_DEVICE_PERSISTENT_LINK_MASK
    bool "Enable persitent link mask"
    help
      The Sidewalk link mask persists after a device reset
      but defaults after a factory reset.
      This could affect the flash lifespan.

config SID_END_DEVICE_EVENT_HEAP_SIZE
    int "Heap for Sidewalk event contexts"
    default 2048

config SIDEWALK_FILE_TRANSFER
    select EXPERIMENTAL
    bool "Enable Sidewalk file transfer"
    help
      Add support for Sidewalk Bulk Data Transfer (SBDT)
      in application.

if SIDEWALK_FILE_TRANSFER

config SIDEWALK_FILE_TRANSFER_HEAP_SIZE
    int "Sidewalk file transfer heap size"
    default 10240
    help
        Heap size in bytes to be allocated
        for Sidewalk Bulk Data Transfer (SBDT).

choice SIDEWALK_FILE_TRANSFER_IMPL
    prompt "Select which implementation of SBDT to use"
    default SIDEWALK_FILE_TRANSFER_DFU

config SIDEWALK_FILE_TRANSFER_DFU
    bool "Sidewalk file transfer and dfu"
    imply SIDEWALK_DFU_IMG_UTILS
    imply DFU_MULTI_IMAGE
    imply DFU_TARGET
    imply DFU_TARGET_MCUBOOT
    imply STREAM_FLASH
    imply STREAM_FLASH_ERASE
    help
        Save recived data to flash. Expect CBOR manifest.
        Autoatically reset device after file transfer.

config SIDEWALK_FILE_TRANSFER_SHELL
    bool "SBDT cli backend for file transfer"
    depends on n
    help
        Disabled: CLI backend removed from this application.

endchoice

config SBDT_MAX_PARALEL_TRANSFERS
    int "maximum number of sbdt paralel transfers"
    default 3

endif # SIDEWALK_FILE_TRANSFER

config SIDEWALK_LOCATION_SHELL
    bool "Enable Sidewalk Location CLI"
    depends on n
    help
        Enables Sidewalk location and dult command line interface.
        Provides commands for location services and unwanted location tracking.

if SIDEWALK_CRYPTO

choice CC3XX_LOCK_VARIANT
	default CC3XX_ATOMIC_LOCK if SOC_NRF52840
	default CC3XX_HW_MUTEX_LOCK if SOC_NRF5340_CPUAPP
endchoice

config PSA_WANT_ALG_SHA_512
	default y if SOC_SERIES_NRF54LX

config PSA_WANT_ALG_CHACHA20_POLY1305
	default n

config PSA_WANT_ALG_SHA_224
	default n

config PSA_WANT_ALG_SHA_384
	default n

config PSA_WANT_ALG_CBC_NO_PADDING
	default n

config PSA_WANT_ALG_CBC_PKCS7
	default n

config PSA_WANT_ALG_HKDF
	default n

config PSA_USE_CC3XX_KEY_AGREEMENT_DRIVER
	default n if SOC_NRF52840 || SOC_NRF5340_CPUAPP

config PSA_USE_CC3XX_ASYMMETRIC_SIGNATURE_DRIVER
	default n if SOC_NRF52840 || SOC_NRF5340_CPUAPP

config PSA_USE_CC3XX_ASYMMETRIC_ENCRYPTION_DRIVER
	default n if SOC_NRF52840 || SOC_NRF5340_CPUAPP

config PSA_USE_CC3XX_KEY_MANAGEMENT_DRIVER
	default n if SOC_NRF52840 || SOC_NRF5340_CPUAPP

endif #SIDEWALK_CRYPTO

source "Kconfig.zephyr"
```
