## CMakeLists.txt
```
cmake_minimum_required(VERSION 3.20.0)

find_package(Zephyr REQUIRED HINTS $ENV{ZEPHYR_BASE})
project(hello_rtt)

target_sources(app PRIVATE src/main.c)
```

## prj.conf
```kconfig
# Minimal base config
CONFIG_BOOTLOADER_MCUBOOT=n
CONFIG_SB_CONFIG_BOOTLOADER_MCUBOOT=n

# Make faults loud and immediate
CONFIG_LOG=y
CONFIG_LOG_MODE_IMMEDIATE=y
CONFIG_PRINTK=y
CONFIG_BOOT_BANNER=y

# Show useful crash info
CONFIG_EXCEPTION_STACK_TRACE=y
CONFIG_FAULT_DUMP=2
CONFIG_ASSERT=y
CONFIG_ASSERT_VERBOSE=y

# Keep RTT console/log
CONFIG_USE_SEGGER_RTT=y
CONFIG_RTT_CONSOLE=y
CONFIG_LOG_BACKEND_RTT=y

# Ensure UART isn't stealing output
CONFIG_UART_CONSOLE=n
CONFIG_LOG_BACKEND_UART=n
```

## rtt.conf
```kconfig
CONFIG_USE_SEGGER_RTT=y
CONFIG_RTT_CONSOLE=y
CONFIG_PRINTK=y

CONFIG_LOG=y
CONFIG_LOG_MODE_IMMEDIATE=y
CONFIG_LOG_BACKEND_RTT=y

CONFIG_UART_CONSOLE=n
CONFIG_LOG_BACKEND_UART=n

CONFIG_SEGGER_RTT_MAX_NUM_UP_BUFFERS=2
CONFIG_SEGGER_RTT_MAX_NUM_DOWN_BUFFERS=2

CONFIG_WATCHDOG=n
```

## src/main.c
```c
#include <zephyr/kernel.h>
#include <zephyr/logging/log.h>

#include <SEGGER_RTT.h>

LOG_MODULE_REGISTER(hello_rtt, LOG_LEVEL_INF);

static void rtt_setup(void)
{
    // Channel 0 is typically used by Zephyr's RTT console/log backend.
    // We'll use channel 1 for "sideband" output + down/input.
    static char up1_buf[256];
    static char down1_buf[64];

    SEGGER_RTT_ConfigUpBuffer(1, "up1", up1_buf, sizeof(up1_buf),
                             SEGGER_RTT_MODE_NO_BLOCK_SKIP);
    SEGGER_RTT_ConfigDownBuffer(1, "down1", down1_buf, sizeof(down1_buf),
                               SEGGER_RTT_MODE_NO_BLOCK_SKIP);
}

int main(void)
{
    rtt_setup();

    uint32_t n = 0;
    char buf[64];

    printk("RTT hello_rtt boot (ch0 printk)\n");
    LOG_INF("RTT hello_rtt boot (LOG_INF)");

    while (1) {
        // Heartbeat on ch0 (printk) and ch1 (SEGGER RTT direct)
        printk("hb %u (ch0)\n", n);

        /* Smallest change: avoid SEGGER_RTT_printf (not linked in this build). */
        SEGGER_RTT_WriteString(1, "hb (ch1)\n");

        // Best-effort down/input from ch1
        int r = SEGGER_RTT_Read(1, buf, sizeof(buf) - 1);
        if (r > 0) {
            buf[r] = '\0';
            printk("RX ch1 (%d): %s\n", r, buf);
        }

        n++;
        k_sleep(K_MSEC(1000));
    }
}
```
