## CMakeLists.txt
```
#
# Copyright (c) 2023 Nordic Semiconductor ASA
#
# SPDX-License-Identifier: LicenseRef-Nordic-5-Clause
#

cmake_minimum_required(VERSION 3.20.0)

# Zephyr CMake project
find_package(Zephyr REQUIRED HINTS $ENV{ZEPHYR_BASE})
project(sidewalk_sid_end_device)

# Source files
target_include_directories(app PRIVATE include src)
target_sources(app PRIVATE
src/main.c
src/sidewalk.c
src/sidewalk_events.c
src/gpio_event.c
src/sidewalk_msg.c
src/telemetry/telemetry_gpio.c
src/telemetry/telemetry_evse.c
src/time_sync.c
)

target_sources_ifdef(CONFIG_SID_END_DEVICE_EVSE_ENABLED app PRIVATE
    src/evse.c
)

target_sources_ifdef(CONFIG_SIDEWALK_FILE_TRANSFER app PRIVATE 
    src/sbdt/scratch_buffer.c
)
target_sources_ifdef(CONFIG_SIDEWALK_FILE_TRANSFER_DFU app PRIVATE
    src/sbdt/dfu_file_transfer.c
)

if(CONFIG_SID_END_DEVICE_SENSOR_MONITORING)
    target_sources(app PRIVATE
        src/sensor_monitoring/app_buttons.c
        src/sensor_monitoring/app_leds.c
        src/sensor_monitoring/app_sensor.c
        src/sensor_monitoring/app_tx.c
        src/sensor_monitoring/app_rx.c
        src/sensor_monitoring/app.c
    )
elseif(CONFIG_SID_END_DEVICE_DUT)
    target_sources(app PRIVATE
        src/cli/app.c
    )
else()
    target_sources(app PRIVATE
        src/hello/app.c
    )
endif()

if(CONFIG_SID_END_DEVICE_CLI)
    target_sources(app PRIVATE
        src/cli/app_dut.c
        src/cli/app_shell.c
    )
    target_sources_ifdef(CONFIG_SIDEWALK_FILE_TRANSFER_SHELL app PRIVATE
        src/cli/sbdt_shell.c
        src/cli/sbdt_shell_events.c
        src/cli/sbdt_shell_file_transfer.c
    )
    target_sources_ifdef(CONFIG_SIDEWALK_ON_DEV_CERT app PRIVATE 
        src/cli/sid_on_dev_cert_cli.c
    )
    target_sources_ifdef(CONFIG_SIDEWALK_LOCATION_SHELL app PRIVATE
        src/cli/location_shell.c
        src/cli/location_shell_events.c
    )
endif()
```

## Kconfig
```
#
# Copyright (c) 2022 Nordic Semiconductor ASA
#
# SPDX-License-Identifier: LicenseRef-Nordic-5-Clause
#

mainmenu "Sidewalk End Device nRF Connect Application"

choice SID_END_DEVICE
	prompt "Select application variant to run"
    default SID_END_DEVICE_HELLO
config SID_END_DEVICE_HELLO
    bool "Sidewalk hello world application"
config SID_END_DEVICE_DUT
    bool "Device under test application"
endchoice #SID_END_DEVICE

if SID_END_DEVICE_HELLO

config SID_END_DEVICE_ECHO_MSGS
    bool "Eable message echo feature"
    default y
    help
      Echo received messages back to Sidewlak cloud.
      Works with GET and SET messages types.

config SID_END_DEVICE_GPIO_EVENTS
    bool "Enable GPIO change events"
    default y
    help
      Sends a Sidewalk uplink when a GPIO input changes.

config SID_END_DEVICE_GPIO_DEBOUNCE_MS
    int "GPIO debounce time (ms)"
    default 50
    help
      Minimum time a new GPIO state must be stable before reporting.

config SID_END_DEVICE_GPIO_POLL_INTERVAL_MS
    int "GPIO polling interval (ms)"
    default 100
    help
      Polling interval when interrupts are unavailable.

config SID_END_DEVICE_GPIO_SIM_INTERVAL_MS
    int "GPIO simulator interval (ms)"
    default 2000
    help
      Interval for toggling the simulator input.

config SID_END_DEVICE_GPIO_SIMULATOR
    bool "Enable GPIO input simulator"
    default y
    depends on SID_END_DEVICE_GPIO_EVENTS
    help
      Simulate a GPIO input change on a timer. Disable this when wiring
      a real input to the extinput0 alias.

config SID_END_DEVICE_GPIO_TEST_MODE
    bool "Enable GPIO test mode (E2E)"
    default n
    depends on SID_END_DEVICE_GPIO_EVENTS
    help
      Generates a run_id at boot and includes it in GPIO payloads.

config SID_END_DEVICE_GPIO_TEST_TRANSITIONS
    int "Number of simulated transitions in test mode"
    default 6
    depends on SID_END_DEVICE_GPIO_TEST_MODE
    help
      Total simulated transitions before stopping the test.

config SID_END_DEVICE_EVSE_ENABLED
    bool "Enable EVSE (J1772) sensing"
    default y
    depends on GPIO && ADC
    help
      Enables pilot voltage, PWM duty cycle, proximity, and current sensing.

config SID_END_DEVICE_EVSE_SAMPLE_INTERVAL_MS
    int "EVSE sample interval (ms)"
    default 2000
    help
      Polling interval for pilot/current/proximity updates.

config SID_END_DEVICE_EVSE_PWM_GPIO_PORT
    int "EVSE PWM GPIO port (0 or 1)"
    default 0
    help
      GPIO port for pilot PWM input.

config SID_END_DEVICE_EVSE_PWM_GPIO_PIN
    int "EVSE PWM GPIO pin"
    default 1
    help
      GPIO pin for pilot PWM input capture.

config SID_END_DEVICE_EVSE_PROX_GPIO_PORT
    int "EVSE proximity GPIO port (0 or 1)"
    default 0
    help
      GPIO port for proximity detect input.

config SID_END_DEVICE_EVSE_PROX_GPIO_PIN
    int "EVSE proximity GPIO pin"
    default 4
    help
      GPIO pin for proximity detect input.

config SID_END_DEVICE_EVSE_PILOT_ADC_CHANNEL
    int "EVSE pilot ADC channel"
    default 2
    help
      ADC channel for pilot voltage measurement.

config SID_END_DEVICE_EVSE_CURRENT_ADC_CHANNEL
    int "EVSE current ADC channel"
    default 3
    help
      ADC channel for current sensor input.

config SID_END_DEVICE_EVSE_PILOT_SCALE_NUM
    int "Pilot voltage scale numerator"
    default 1
    help
      Multiplier applied to pilot ADC mV reading.

config SID_END_DEVICE_EVSE_PILOT_SCALE_DEN
    int "Pilot voltage scale denominator"
    default 1
    help
      Divider applied to pilot ADC mV reading.

config SID_END_DEVICE_EVSE_PILOT_BIAS_MV
    int "Pilot voltage bias (mV)"
    default 0
    help
      Bias to subtract for recovering negative pilot voltages.

config SID_END_DEVICE_EVSE_CURRENT_SCALE_NUM
    int "Current scale numerator (mA per mV)"
    default 1
    help
      Multiplier applied to current ADC mV reading.

config SID_END_DEVICE_EVSE_CURRENT_SCALE_DEN
    int "Current scale denominator (mA per mV)"
    default 1
    help
      Divider applied to current ADC mV reading.

config SID_END_DEVICE_EVSE_NOMINAL_VOLTAGE_V
    int "Nominal line voltage (V)"
    default 240
    help
      Used for kWh estimation (current * voltage).

config SID_END_DEVICE_EVSE_PILOT_TOLERANCE_MV
    int "Pilot state tolerance (mV)"
    default 1000
    help
      Tolerance applied to pilot voltage state mapping.

config SID_END_DEVICE_DEVICE_ID
    string "Device ID for telemetry payloads"
    default "unknown"
    help
      Identifier included in outbound telemetry JSON.

config SID_END_DEVICE_DEVICE_TYPE
    string "Device type for telemetry payloads"
    default "evse"
    help
      Device type included in outbound telemetry JSON.

endif #SID_END_DEVICE_HELLO

config SID_END_DEVICE_CLI
    bool "Enable Sidewalk CLI (DUT)"
    imply SHELL
    help
      Enables Sidewalk command line interface.
      The interface commands are compatilbe with former dut sample.

if SID_END_DEVICE_CLI

config SHELL_CMD_BUFF_SIZE
	default 1024

config SHELL_STACK_SIZE
	default 8192

config SHELL_BACKEND_SERIAL_TX_RING_BUFFER_SIZE
	default 128

config SHELL_BACKEND_SERIAL_RX_RING_BUFFER_SIZE
	default 1024

config SID_END_DEVICE_CLI_ALIVE_MAKRER
    bool "Enable alive marker"
    help
        Enable alive marker that periodically prints "alive" message to log.
        Useful to verify that application is running and not stuck.

endif # SID_END_DEVICE_CLI

config SID_END_DEVICE_AUTO_START
    default y
    bool "Enable automatic Sidewalk initlization and start"

config SID_END_DEVICE_AUTO_CONN_REQ
    default y
    bool "Enable automatic connection request before message send"

config SID_END_DEVICE_PERSISTENT_LINK_MASK
    bool "Enable persitent link mask"
    help
      The Sidewalk link mask persists after a device reset
      but defaults after a factory reset.
      This could affect the flash lifespan.

config SID_END_DEVICE_EVENT_HEAP_SIZE
    int "Heap for Sidewalk event contexts"
    default 2048

config SIDEWALK_FILE_TRANSFER
    select EXPERIMENTAL
    bool "Enable Sidewalk file transfer"
    help
      Add support for Sidewalk Bulk Data Transfer (SBDT)
      in application.

if SIDEWALK_FILE_TRANSFER

config SIDEWALK_FILE_TRANSFER_HEAP_SIZE
    int "Sidewalk file transfer heap size"
    default 10240
    help
        Heap size in bytes to be allocated
        for Sidewalk Bulk Data Transfer (SBDT).

choice SIDEWALK_FILE_TRANSFER_IMPL
    prompt "Select which implementation of SBDT to use"
    default SIDEWALK_FILE_TRANSFER_DFU

config SIDEWALK_FILE_TRANSFER_DFU
    bool "Sidewalk file transfer and dfu"
    imply SIDEWALK_DFU_IMG_UTILS
    imply DFU_MULTI_IMAGE
    imply DFU_TARGET
    imply DFU_TARGET_MCUBOOT
    imply STREAM_FLASH
    imply STREAM_FLASH_ERASE
    help
        Save recived data to flash. Expect CBOR manifest.
        Autoatically reset device after file transfer.

config SIDEWALK_FILE_TRANSFER_SHELL
    bool "SBDT cli backend for file transfer"
    imply SHELL
    help
        Use shell commands to controll file transfer.
        This implementation does not save received data,
        but allows user to controll the sbdt behaviour form shell.

endchoice

config SBDT_MAX_PARALEL_TRANSFERS
    int "maximum number of sbdt paralel transfers"
    default 3

endif # SIDEWALK_FILE_TRANSFER

config SIDEWALK_LOCATION_SHELL
    bool "Enable Sidewalk Location CLI"
    depends on SID_END_DEVICE_CLI
    help
        Enables Sidewalk location and dult command line interface.
        Provides commands for location services and unwanted location tracking.

if SIDEWALK_CRYPTO

choice CC3XX_LOCK_VARIANT
	default CC3XX_ATOMIC_LOCK if SOC_NRF52840
	default CC3XX_HW_MUTEX_LOCK if SOC_NRF5340_CPUAPP
endchoice

config PSA_WANT_ALG_SHA_512
	default y if SOC_SERIES_NRF54LX

config PSA_WANT_ALG_CHACHA20_POLY1305
	default n

config PSA_WANT_ALG_SHA_224
	default n

config PSA_WANT_ALG_SHA_384
	default n

config PSA_WANT_ALG_CBC_NO_PADDING
	default n

config PSA_WANT_ALG_CBC_PKCS7
	default n

config PSA_WANT_ALG_HKDF
	default n

config PSA_USE_CC3XX_KEY_AGREEMENT_DRIVER
	default n if SOC_NRF52840 || SOC_NRF5340_CPUAPP

config PSA_USE_CC3XX_ASYMMETRIC_SIGNATURE_DRIVER
	default n if SOC_NRF52840 || SOC_NRF5340_CPUAPP

config PSA_USE_CC3XX_ASYMMETRIC_ENCRYPTION_DRIVER
	default n if SOC_NRF52840 || SOC_NRF5340_CPUAPP

config PSA_USE_CC3XX_KEY_MANAGEMENT_DRIVER
	default n if SOC_NRF52840 || SOC_NRF5340_CPUAPP

endif #SIDEWALK_CRYPTO

if SHELL
# TODO: Remove when merged in NCS copy of sdk-zephyr https://github.com/zephyrproject-rtos/zephyr/pull/85790
# Workaround for missing first few logs.
    config LOG_BACKEND_RTT
        bool "Segger J-Link RTT backend"
        depends on USE_SEGGER_RTT
        default y if !SHELL_LOG_BACKEND
        default n
endif #SHELL



source "Kconfig.zephyr"
```

## sample.yaml
```
sample:
  name: Sidewalk end device sample
  description: Sample implementing Amazon Sidewalk End Device
common:
  sysbuild: true
  build_only: true
  platform_allow:
    - nrf52840dk/nrf52840
    - nrf5340dk/nrf5340/cpuapp
    - nrf54l15dk/nrf54l15/cpuapp
    - nrf54l15dk/nrf54l15/cpuapp/ns
    - nrf54l15dk/nrf54l10/cpuapp
tests:
  sample.sidewalk.hello.sx1262:
    integration_platforms:
      - nrf52840dk/nrf52840
      - nrf5340dk/nrf5340/cpuapp
      - nrf54l15dk/nrf54l15/cpuapp
      - nrf54l15dk/nrf54l15/cpuapp/ns
      - nrf54l15dk/nrf54l10/cpuapp
    extra_args:
      - OVERLAY_CONFIG="config/overlays/overlay-sidewalk_logging_v1.conf"
      - SHIELD="simple_arduino_adapter;semtech_sx1262mb2cas"
    extra_configs:
      - CONFIG_SID_END_DEVICE_PERSISTENT_LINK_MASK=y
      - CONFIG_SIDEWALK_FILE_TRANSFER=y
      - CONFIG_SIDEWALK_APPLICATION_NAME="hello"
    tags:
      - Sidewalk
      - hello
      - sx1262

  sample.sidewalk.hello.lr1110:
    platform_exclude:
      - nrf5340dk/nrf5340/cpuapp
    integration_platforms:
      - nrf52840dk/nrf52840
      - nrf54l15dk/nrf54l15/cpuapp
      - nrf54l15dk/nrf54l15/cpuapp/ns
      - nrf54l15dk/nrf54l10/cpuapp
    extra_args:
      - OVERLAY_CONFIG="config/overlays/overlay-sidewalk_logging_v1.conf"
      - SHIELD="simple_arduino_adapter;semtech_lr1110mb1xxs"
    extra_configs:
      - CONFIG_SID_END_DEVICE_PERSISTENT_LINK_MASK=y
      - CONFIG_SIDEWALK_FILE_TRANSFER=y
      - CONFIG_SIDEWALK_APPLICATION_NAME="hello"
    tags:
      - Sidewalk
      - hello
      - lr1110

  sample.sidewalk.hello.release.sx1262:
    integration_platforms:
      - nrf52840dk/nrf52840
      - nrf5340dk/nrf5340/cpuapp
      - nrf54l15dk/nrf54l15/cpuapp
      - nrf54l15dk/nrf54l15/cpuapp/ns
      - nrf54l15dk/nrf54l10/cpuapp
    extra_args:
      - FILE_SUFFIX=release
      - OVERLAY_CONFIG="config/overlays/overlay-sidewalk_logging_v1.conf"
      - SHIELD="simple_arduino_adapter;semtech_sx1262mb2cas"
    extra_configs:
      - CONFIG_SID_END_DEVICE_PERSISTENT_LINK_MASK=y
      - CONFIG_SIDEWALK_APPLICATION_NAME="hello.release"
    tags:
      - Sidewalk
      - hello
      - sx1262

  sample.sidewalk.hello.release.lr1110:
    platform_exclude:
      - nrf5340dk/nrf5340/cpuapp
    integration_platforms:
      - nrf52840dk/nrf52840
      - nrf54l15dk/nrf54l15/cpuapp
      - nrf54l15dk/nrf54l15/cpuapp/ns
      - nrf54l15dk/nrf54l10/cpuapp
    extra_args:
      - FILE_SUFFIX=release
      - OVERLAY_CONFIG="config/overlays/overlay-sidewalk_logging_v1.conf"
      - SHIELD="simple_arduino_adapter;semtech_lr1110mb1xxs"

    extra_configs:
      - CONFIG_SID_END_DEVICE_PERSISTENT_LINK_MASK=y
      - CONFIG_SIDEWALK_APPLICATION_NAME="hello.release"
    tags:
      - Sidewalk
      - hello
      - lr1110

  sample.sidewalk.hello.ble_only:
    integration_platforms:
      - nrf52840dk/nrf52840
      - nrf5340dk/nrf5340/cpuapp
      - nrf54l15dk/nrf54l15/cpuapp
      - nrf54l15dk/nrf54l15/cpuapp/ns
      - nrf54l15dk/nrf54l10/cpuapp
    extra_configs:
      - CONFIG_SIDEWALK_APPLICATION_NAME="hello.ble_only"
    tags:
      - Sidewalk
      - hello
      - BLE

  sample.sidewalk.hello.ble_only.release:
    integration_platforms:
      - nrf52840dk/nrf52840
      - nrf5340dk/nrf5340/cpuapp
      - nrf54l15dk/nrf54l15/cpuapp
      - nrf54l15dk/nrf54l15/cpuapp/ns
      - nrf54l15dk/nrf54l10/cpuapp
    extra_args: FILE_SUFFIX=release
    extra_configs:
      - CONFIG_SIDEWALK_APPLICATION_NAME="hello.ble_only.release"
    tags:
      - Sidewalk
      - hello
      - BLE

  sample.sidewalk.dut.sx1262:
    integration_platforms:
      - nrf52840dk/nrf52840
      - nrf5340dk/nrf5340/cpuapp
      - nrf54l15dk/nrf54l15/cpuapp
      - nrf54l15dk/nrf54l15/cpuapp/ns
      - nrf54l15dk/nrf54l10/cpuapp
    extra_args:
      - OVERLAY_CONFIG="config/overlays/overlay-dut.conf"
      - SHIELD="simple_arduino_adapter;semtech_sx1262mb2cas"
    extra_configs:
      - CONFIG_SIDEWALK_APPLICATION_NAME="dut"
    tags:
      - Sidewalk
      - cli
      - sx1262

  sample.sidewalk.dut.lr1110:
    platform_exclude:
      - nrf5340dk/nrf5340/cpuapp
      - nrf54l15dk/nrf54l15/cpuapp/ns
    integration_platforms:
      - nrf52840dk/nrf52840
      - nrf54l15dk/nrf54l15/cpuapp
      - nrf54l15dk/nrf54l10/cpuapp
    extra_args:
      - OVERLAY_CONFIG="config/overlays/overlay-dut.conf"
      - SHIELD="simple_arduino_adapter;semtech_lr1110mb1xxs"
    extra_configs:
      - CONFIG_SIDEWALK_APPLICATION_NAME="dut"
    tags:
      - Sidewalk
      - cli
      - lr1110

  sample.sidewalk.dut.ble_only:
    integration_platforms:
      - nrf52840dk/nrf52840
      - nrf5340dk/nrf5340/cpuapp
      - nrf54l15dk/nrf54l15/cpuapp
      - nrf54l15dk/nrf54l15/cpuapp/ns
      - nrf54l15dk/nrf54l10/cpuapp
    extra_args: OVERLAY_CONFIG="config/overlays/overlay-dut.conf"
    extra_configs:
      - CONFIG_SIDEWALK_APPLICATION_NAME="dut.ble_only"
    tags:
      - Sidewalk
      - cli
      - BLE

  sample.sidewalk.dut.no_secure:
    integration_platforms:
      - nrf52840dk/nrf52840
      - nrf5340dk/nrf5340/cpuapp
      - nrf54l15dk/nrf54l15/cpuapp
      - nrf54l15dk/nrf54l15/cpuapp/ns
      - nrf54l15dk/nrf54l10/cpuapp
    extra_args:
      - OVERLAY_CONFIG="config/overlays/overlay-dut.conf"
      - SHIELD="simple_arduino_adapter;semtech_sx1262mb2cas"
    extra_configs:
      - CONFIG_SIDEWALK_CRYPTO_PSA_KEY_STORAGE=n
      - CONFIG_SIDEWALK_APPLICATION_NAME="dut.no_secure"
    tags:
      - Sidewalk
      - cli
      - no_secure

  sample.sidewalk.helloPower.ble.release:
    platform_exclude:
      - nrf52840dk/nrf52840
      - nrf5340dk/nrf5340/cpuapp
      - nrf54l15dk/nrf54l15/cpuapp/ns
      - nrf54l15dk/nrf54l10/cpuapp
    extra_args: FILE_SUFFIX=release
    extra_configs:
      - CONFIG_STATE_NOTIFIER=n
      - CONFIG_SIDEWALK_LINK_MASK_BLE=y
      - CONFIG_SIDEWALK_APPLICATION_NAME="helloPower.release.ble"
    tags:
      - Sidewalk
      - helloPower

  sample.sidewalk.helloPower.fsk.release.sx1262:
    platform_exclude:
      - nrf52840dk/nrf52840
      - nrf5340dk/nrf5340/cpuapp
      - nrf54l15dk/nrf54l15/cpuapp/ns
      - nrf54l15dk/nrf54l10/cpuapp
    extra_args:
      - FILE_SUFFIX=release
      - SHIELD="simple_arduino_adapter;semtech_sx1262mb2cas"
    extra_configs:
      - CONFIG_STATE_NOTIFIER=n
      - CONFIG_SIDEWALK_LINK_MASK_FSK=y
      - CONFIG_SIDEWALK_APPLICATION_NAME="helloPower.release.fsk"
    tags:
      - Sidewalk
      - helloPower
      - sx1262

  sample.sidewalk.helloPower.lora.release.sx1262:
    platform_exclude:
      - nrf52840dk/nrf52840
      - nrf5340dk/nrf5340/cpuapp
      - nrf54l15dk/nrf54l15/cpuapp/ns
      - nrf54l15dk/nrf54l10/cpuapp
    extra_args:
      - FILE_SUFFIX=release
      - SHIELD="simple_arduino_adapter;semtech_sx1262mb2cas"
    extra_configs:
      - CONFIG_STATE_NOTIFIER=n
      - CONFIG_SIDEWALK_LINK_MASK_LORA=y
      - CONFIG_SIDEWALK_APPLICATION_NAME="helloPower.release.lora"
    tags:
      - Sidewalk
      - helloPower
      - sx1262

  sample.sidewalk.helloPower.ble_only.release:
    platform_exclude:
      - nrf52840dk/nrf52840
      - nrf5340dk/nrf5340/cpuapp
      - nrf54l15dk/nrf54l15/cpuapp/ns
      - nrf54l15dk/nrf54l10/cpuapp
    extra_args: FILE_SUFFIX=release
    extra_configs:
      - CONFIG_STATE_NOTIFIER=n
      - CONFIG_SIDEWALK_APPLICATION_NAME="helloPower.ble_only.release"
    tags:
      - Sidewalk
      - helloPower
      - BLE
```

## prj.conf
```kconfig
#
# Copyright (c) 2023 Nordic Semiconductor ASA
#
# SPDX-License-Identifier: LicenseRef-Nordic-5-Clause
#
CONFIG_STATIC_INIT_GNU=y

# Sidewalk
CONFIG_SIDEWALK=y
CONFIG_SMF=y

# Log
CONFIG_LOG=y
CONFIG_LOG_PRINTK=y
CONFIG_LOG_BUFFER_SIZE=4096
# Bluetooth
CONFIG_BT_DEVICE_NAME="Nordic"

# ADC (EVSE)
CONFIG_ADC=y
CONFIG_ADC_NRFX_SAADC=y

# Stack and Heap
CONFIG_SYSTEM_WORKQUEUE_STACK_SIZE=4096
CONFIG_HEAP_MEM_POOL_SIZE=4096
CONFIG_MBEDTLS_HEAP_SIZE=4096

# Power Management
CONFIG_PM_DEVICE=y

# Debug
CONFIG_NCS_APPLICATION_BOOT_BANNER_STRING="Sidewalk"
CONFIG_RESET_ON_FATAL_ERROR=n
CONFIG_SYS_HEAP_RUNTIME_STATS=y
```

## include/evse.h
```c
/*
 * EVSE sensing + state machine (J1772)
 */
#ifndef EVSE_H
#define EVSE_H

#include <stdbool.h>
#include <stdint.h>
#include <stddef.h>

enum evse_pilot_state {
	EVSE_PILOT_A = 0,
	EVSE_PILOT_B,
	EVSE_PILOT_C,
	EVSE_PILOT_D,
	EVSE_PILOT_E,
	EVSE_PILOT_F,
	EVSE_PILOT_UNKNOWN,
};

struct evse_event {
	bool send;
	enum evse_pilot_state pilot_state;
	bool proximity_detected;
	float pwm_duty_cycle;
	float current_draw_a;
	float energy_kwh;
	const char *event_type;
	const char *session_id;
};

struct evse_raw {
	enum evse_pilot_state pilot_state;
	bool proximity_detected;
	float pwm_duty_cycle;
	float current_draw_a;
	int pilot_mv;
};

int evse_init(void);
bool evse_poll(struct evse_event *evt, int64_t timestamp_ms);
int evse_read_raw(struct evse_raw *raw);
char evse_pilot_state_to_char(enum evse_pilot_state state);

#endif /* EVSE_H */
```

## include/gpio_event.h
```c
/*
 * Copyright (c) 2025
 *
 * SPDX-License-Identifier: LicenseRef-Nordic-5-Clause
 */
#ifndef GPIO_EVENT_H
#define GPIO_EVENT_H

#include <stddef.h>
#include <stdint.h>
#include <stdbool.h>

typedef enum {
	GPIO_EDGE_NONE = 0,
	GPIO_EDGE_RISING,
	GPIO_EDGE_FALLING,
	GPIO_EDGE_UNKNOWN,
} gpio_edge_t;

struct gpio_event_state {
	int last_state;
	int pending_state;
	int64_t last_change_ms;
	int64_t debounce_ms;
	bool initialized;
};

void gpio_event_init(struct gpio_event_state *st, int64_t debounce_ms);

gpio_edge_t gpio_event_update(struct gpio_event_state *st, int state, int64_t now_ms,
			      bool *changed);

const char *gpio_edge_str(gpio_edge_t edge);

#endif /* GPIO_EVENT_H */
```

## include/time_sync.h
```c
/*
 * Simple epoch time sync helper
 */
#ifndef TIME_SYNC_H
#define TIME_SYNC_H

#include <stdbool.h>
#include <stdint.h>

void time_sync_init(void);
void time_sync_apply_epoch_ms(int64_t epoch_ms, int64_t uptime_ms);
int64_t time_sync_get_timestamp_ms(int64_t uptime_ms);
bool time_sync_is_synced(void);
bool time_sync_time_anomaly(void);

#endif /* TIME_SYNC_H */
```

## src/evse.c
```c
/*
 * EVSE sensing + state machine (J1772)
 */
#include "evse.h"

#include <zephyr/device.h>
#include <zephyr/drivers/adc.h>
#include <zephyr/drivers/gpio.h>
#include <zephyr/kernel.h>
#include <zephyr/logging/log.h>
#include <zephyr/random/random.h>
#include <zephyr/sys/util.h>
#include <stdio.h>
#include <string.h>
#include <errno.h>
#if defined(CONFIG_ADC_NRFX_SAADC)
#include <hal/nrf_saadc.h>
#endif

LOG_MODULE_REGISTER(evse, CONFIG_SIDEWALK_LOG_LEVEL);

#define ADC_RESOLUTION 12
#define ADC_GAIN ADC_GAIN_1_6
#define ADC_REFERENCE ADC_REF_INTERNAL
#define EVSE_ADC_ACQ_TIME ADC_ACQ_TIME_DEFAULT

#define EVSE_PWM_PORT CONFIG_SID_END_DEVICE_EVSE_PWM_GPIO_PORT
#define EVSE_PWM_PIN CONFIG_SID_END_DEVICE_EVSE_PWM_GPIO_PIN
#define EVSE_PROX_PORT CONFIG_SID_END_DEVICE_EVSE_PROX_GPIO_PORT
#define EVSE_PROX_PIN CONFIG_SID_END_DEVICE_EVSE_PROX_GPIO_PIN

#define EVSE_PILOT_CH CONFIG_SID_END_DEVICE_EVSE_PILOT_ADC_CHANNEL
#define EVSE_CURRENT_CH CONFIG_SID_END_DEVICE_EVSE_CURRENT_ADC_CHANNEL

#define EVSE_PILOT_SCALE_NUM CONFIG_SID_END_DEVICE_EVSE_PILOT_SCALE_NUM
#define EVSE_PILOT_SCALE_DEN CONFIG_SID_END_DEVICE_EVSE_PILOT_SCALE_DEN
#define EVSE_PILOT_BIAS_MV CONFIG_SID_END_DEVICE_EVSE_PILOT_BIAS_MV

#define EVSE_CURRENT_SCALE_NUM CONFIG_SID_END_DEVICE_EVSE_CURRENT_SCALE_NUM
#define EVSE_CURRENT_SCALE_DEN CONFIG_SID_END_DEVICE_EVSE_CURRENT_SCALE_DEN

#define EVSE_NOMINAL_VOLTAGE_V CONFIG_SID_END_DEVICE_EVSE_NOMINAL_VOLTAGE_V
#define EVSE_PILOT_TOL_MV CONFIG_SID_END_DEVICE_EVSE_PILOT_TOLERANCE_MV

static const struct device *adc_dev;
static const struct device *pwm_gpio_dev;
static const struct device *prox_gpio_dev;
static struct gpio_callback pwm_cb;

static volatile int64_t pwm_last_rise_us;
static volatile int64_t pwm_last_high_us;
static volatile int64_t pwm_last_period_us;

static enum evse_pilot_state last_pilot_state = EVSE_PILOT_UNKNOWN;
static bool last_prox_state;
static float energy_kwh;
static char session_id[37];
static bool session_active;
static int64_t last_energy_ts_ms;

static int64_t cycles_to_us(uint32_t cycles)
{
	return (int64_t)k_cyc_to_us_floor64(cycles);
}

static void pwm_isr(const struct device *dev, struct gpio_callback *cb, uint32_t pins)
{
	ARG_UNUSED(dev);
	ARG_UNUSED(cb);
	ARG_UNUSED(pins);

	uint32_t now_cycles = k_cycle_get_32();
	int val = gpio_pin_get(pwm_gpio_dev, EVSE_PWM_PIN);
	int64_t now_us = cycles_to_us(now_cycles);

	if (val > 0) {
		if (pwm_last_rise_us > 0) {
			pwm_last_period_us = now_us - pwm_last_rise_us;
		}
		pwm_last_rise_us = now_us;
	} else {
		if (pwm_last_rise_us > 0) {
			pwm_last_high_us = now_us - pwm_last_rise_us;
		}
	}
}

static const struct device *gpio_dev_from_port(int port)
{
	switch (port) {
	case 0:
		return DEVICE_DT_GET(DT_NODELABEL(gpio0));
#if DT_NODE_HAS_STATUS(DT_NODELABEL(gpio1), okay)
	case 1:
		return DEVICE_DT_GET(DT_NODELABEL(gpio1));
#endif
	default:
		return NULL;
	}
}

static void log_gpio_mapping(const char *label, int port, int pin)
{
	LOG_INF("%s GPIO: P%d.%02d", label, port, pin);
}

static float pwm_get_duty_cycle(void)
{
	int64_t period = pwm_last_period_us;
	int64_t high = pwm_last_high_us;
	if (period <= 0 || high <= 0 || high > period) {
		return 0.0f;
	}
	return (float)high * 100.0f / (float)period;
}

static int adc_read_channel(int channel, int16_t *out)
{
	struct adc_channel_cfg cfg = {
		.gain = ADC_GAIN,
		.reference = ADC_REFERENCE,
		.acquisition_time = EVSE_ADC_ACQ_TIME,
		.channel_id = channel,
		.differential = 0,
	};
#if defined(CONFIG_ADC_NRFX_SAADC)
	cfg.input_positive = NRF_SAADC_INPUT_AIN0 + channel;
#endif
	int ret = adc_channel_setup(adc_dev, &cfg);
	if (ret) {
		return ret;
	}

	int16_t buf = 0;
	struct adc_sequence seq = {
		.channels = BIT(channel),
		.buffer = &buf,
		.buffer_size = sizeof(buf),
		.resolution = ADC_RESOLUTION,
	};
	ret = adc_read(adc_dev, &seq);
	if (ret) {
		return ret;
	}
	*out = buf;
	return 0;
}

static int adc_raw_to_mv(int16_t raw)
{
	int32_t mv = raw;
	(void)adc_raw_to_millivolts(ADC_REFERENCE, ADC_GAIN, ADC_RESOLUTION, &mv);
	return (int)mv;
}

static int pilot_mv_from_adc(void)
{
	int16_t raw = 0;
	if (adc_read_channel(EVSE_PILOT_CH, &raw)) {
		return 0;
	}
	int mv = adc_raw_to_mv(raw);
	/* scale and remove bias to recover negative range */
	int scaled = (mv * EVSE_PILOT_SCALE_NUM) / EVSE_PILOT_SCALE_DEN;
	return scaled - EVSE_PILOT_BIAS_MV;
}

static float current_a_from_adc(void)
{
	int16_t raw = 0;
	if (adc_read_channel(EVSE_CURRENT_CH, &raw)) {
		return 0.0f;
	}
	int mv = adc_raw_to_mv(raw);
	int scaled = (mv * EVSE_CURRENT_SCALE_NUM) / EVSE_CURRENT_SCALE_DEN;
	return (float)scaled / 1000.0f;
}

static enum evse_pilot_state pilot_state_from_mv(int mv)
{
	if (mv >= 12000 - EVSE_PILOT_TOL_MV) {
		return EVSE_PILOT_A;
	}
	if (mv >= 9000 - EVSE_PILOT_TOL_MV) {
		return EVSE_PILOT_B;
	}
	if (mv >= 6000 - EVSE_PILOT_TOL_MV) {
		return EVSE_PILOT_C;
	}
	if (mv >= 3000 - EVSE_PILOT_TOL_MV) {
		return EVSE_PILOT_D;
	}
	if (mv >= -1000 - EVSE_PILOT_TOL_MV) {
		return EVSE_PILOT_E;
	}
	return EVSE_PILOT_F;
}

char evse_pilot_state_to_char(enum evse_pilot_state state)
{
	switch (state) {
	case EVSE_PILOT_A:
		return 'A';
	case EVSE_PILOT_B:
		return 'B';
	case EVSE_PILOT_C:
		return 'C';
	case EVSE_PILOT_D:
		return 'D';
	case EVSE_PILOT_E:
		return 'E';
	case EVSE_PILOT_F:
		return 'F';
	default:
		return '?';
	}
}

static void session_id_new(void)
{
	uint32_t r[4] = {
		sys_rand32_get(),
		sys_rand32_get(),
		sys_rand32_get(),
		sys_rand32_get(),
	};
	snprintf(session_id, sizeof(session_id),
		 "%08x-%04x-%04x-%04x-%04x%04x%04x",
		 r[0],
		 (r[1] >> 16) & 0xFFFF,
		 r[1] & 0xFFFF,
		 (r[2] >> 16) & 0xFFFF,
		 r[2] & 0xFFFF,
		 (r[3] >> 16) & 0xFFFF,
		 r[3] & 0xFFFF);
}

int evse_init(void)
{
	adc_dev = DEVICE_DT_GET_ANY(nordic_nrf_saadc);
	if (!adc_dev || !device_is_ready(adc_dev)) {
		LOG_ERR("ADC not ready");
		return -ENODEV;
	}

	pwm_gpio_dev = gpio_dev_from_port(EVSE_PWM_PORT);
	prox_gpio_dev = gpio_dev_from_port(EVSE_PROX_PORT);
	if (!pwm_gpio_dev || !prox_gpio_dev || !device_is_ready(pwm_gpio_dev) ||
	    !device_is_ready(prox_gpio_dev)) {
		LOG_ERR("GPIO not ready");
		return -ENODEV;
	}

	log_gpio_mapping("EVSE PWM", EVSE_PWM_PORT, EVSE_PWM_PIN);
	log_gpio_mapping("EVSE PROX", EVSE_PROX_PORT, EVSE_PROX_PIN);
	LOG_INF("EVSE ADC channels: pilot=%d current=%d", EVSE_PILOT_CH, EVSE_CURRENT_CH);

	if (gpio_pin_configure(pwm_gpio_dev, EVSE_PWM_PIN, GPIO_INPUT)) {
		return -EINVAL;
	}
	if (gpio_pin_interrupt_configure(pwm_gpio_dev, EVSE_PWM_PIN, GPIO_INT_EDGE_BOTH)) {
		return -EINVAL;
	}
	gpio_init_callback(&pwm_cb, pwm_isr, BIT(EVSE_PWM_PIN));
	gpio_add_callback(pwm_gpio_dev, &pwm_cb);

	if (gpio_pin_configure(prox_gpio_dev, EVSE_PROX_PIN, GPIO_INPUT)) {
		return -EINVAL;
	}

	last_prox_state = gpio_pin_get(prox_gpio_dev, EVSE_PROX_PIN) > 0;
	last_pilot_state = EVSE_PILOT_UNKNOWN;
	energy_kwh = 0.0f;
	session_active = false;
	last_energy_ts_ms = 0;
	memset(session_id, 0, sizeof(session_id));
	return 0;
}

bool evse_poll(struct evse_event *evt, int64_t timestamp_ms)
{
	if (!evt) {
		return false;
	}

	int pilot_mv = pilot_mv_from_adc();
	enum evse_pilot_state state = pilot_state_from_mv(pilot_mv);
	bool prox = gpio_pin_get(prox_gpio_dev, EVSE_PROX_PIN) > 0;
	float current_a = current_a_from_adc();
	float duty = pwm_get_duty_cycle();

	/* energy accumulation during charge states */
	if (last_energy_ts_ms > 0 && (state == EVSE_PILOT_C || state == EVSE_PILOT_D)) {
		float dt_h = (float)(timestamp_ms - last_energy_ts_ms) / 3600000.0f;
		float power_kw = (current_a * (float)EVSE_NOMINAL_VOLTAGE_V) / 1000.0f;
		if (dt_h > 0) {
			energy_kwh += power_kw * dt_h;
		}
	}
	last_energy_ts_ms = timestamp_ms;

	evt->send = false;
	evt->pilot_state = state;
	evt->proximity_detected = prox;
	evt->pwm_duty_cycle = duty;
	evt->current_draw_a = current_a;
	evt->energy_kwh = energy_kwh;
	evt->session_id = session_id[0] ? session_id : NULL;
	evt->event_type = "state_change";

	if (state != last_pilot_state || prox != last_prox_state) {
		evt->send = true;
		if (last_pilot_state == EVSE_PILOT_A && state == EVSE_PILOT_B) {
			session_id_new();
			session_active = true;
			energy_kwh = 0.0f;
			evt->event_type = "session_start";
		} else if (session_active && state == EVSE_PILOT_A) {
			evt->event_type = "session_end";
			session_active = false;
		}
	}

	last_pilot_state = state;
	last_prox_state = prox;
	return evt->send;
}

int evse_read_raw(struct evse_raw *raw)
{
	if (!raw || !adc_dev || !pwm_gpio_dev || !prox_gpio_dev) {
		return -EINVAL;
	}
	raw->pilot_mv = pilot_mv_from_adc();
	raw->pilot_state = pilot_state_from_mv(raw->pilot_mv);
	raw->proximity_detected = gpio_pin_get(prox_gpio_dev, EVSE_PROX_PIN) > 0;
	raw->pwm_duty_cycle = pwm_get_duty_cycle();
	raw->current_draw_a = current_a_from_adc();
	return 0;
}
```

## src/gpio_event.c
```c
/*
 * Copyright (c) 2025
 *
 * SPDX-License-Identifier: LicenseRef-Nordic-5-Clause
 */
#include "gpio_event.h"

void gpio_event_init(struct gpio_event_state *st, int64_t debounce_ms)
{
	if (!st) {
		return;
	}
	st->last_state = -1;
	st->pending_state = -1;
	st->last_change_ms = 0;
	st->debounce_ms = debounce_ms;
	st->initialized = false;
}

static gpio_edge_t gpio_event_edge(int prev, int now)
{
	if (prev == 0 && now == 1) {
		return GPIO_EDGE_RISING;
	}
	if (prev == 1 && now == 0) {
		return GPIO_EDGE_FALLING;
	}
	return GPIO_EDGE_UNKNOWN;
}

gpio_edge_t gpio_event_update(struct gpio_event_state *st, int state, int64_t now_ms,
			      bool *changed)
{
	if (changed) {
		*changed = false;
	}
	if (!st || state < 0) {
		return GPIO_EDGE_NONE;
	}

	if (!st->initialized) {
		st->initialized = true;
		st->last_state = state;
		st->pending_state = state;
		st->last_change_ms = now_ms;
		return GPIO_EDGE_NONE;
	}

	if (state != st->pending_state) {
		st->pending_state = state;
		st->last_change_ms = now_ms;
		return GPIO_EDGE_NONE;
	}

	if ((now_ms - st->last_change_ms) < st->debounce_ms) {
		return GPIO_EDGE_NONE;
	}

	if (st->pending_state == st->last_state) {
		return GPIO_EDGE_NONE;
	}

	gpio_edge_t edge = gpio_event_edge(st->last_state, st->pending_state);
	st->last_state = st->pending_state;
	if (changed) {
		*changed = true;
	}
	return edge;
}

const char *gpio_edge_str(gpio_edge_t edge)
{
	switch (edge) {
	case GPIO_EDGE_RISING:
		return "rising";
	case GPIO_EDGE_FALLING:
		return "falling";
	case GPIO_EDGE_UNKNOWN:
		return "unknown";
	case GPIO_EDGE_NONE:
	default:
		return "none";
	}
}
```

## src/safety_gate.c
```c
/*
 * Safety gate helper for EV allow/deny decisions.
 */
#include "safety_gate.h"

static bool debounce_valid(int64_t debounce_ms)
{
	return debounce_ms > 0 && debounce_ms <= SAFETY_GATE_MAX_DEBOUNCE_MS;
}

void safety_gate_init(struct safety_gate *gate, int64_t debounce_ms)
{
	if (!gate) {
		return;
	}

	gate->ev_allowed = false;
	gate->time_anomaly = false;
	gate->fault_flags = SAFETY_FAULT_NONE;
	gate->last_timestamp_ms = -1;
	gate->debounce_valid = debounce_valid(debounce_ms);

	if (!gate->debounce_valid) {
		gate->fault_flags |= SAFETY_FAULT_DEBOUNCE_INVALID;
	}

	gpio_event_init(&gate->ac_state, gate->debounce_valid ? debounce_ms : 0);
}

void safety_gate_update_ac(struct safety_gate *gate, int ac_state, int64_t now_ms)
{
	if (!gate) {
		return;
	}

	if (!gate->debounce_valid) {
		gate->ev_allowed = false;
		return;
	}

	if (ac_state < 0) {
		gate->fault_flags |= SAFETY_FAULT_AC_UNKNOWN | SAFETY_FAULT_INVALID_INPUT;
		gate->ev_allowed = false;
		return;
	}

	(void)gpio_event_update(&gate->ac_state, ac_state, now_ms, NULL);

	bool stable_off = gate->ac_state.initialized &&
			  gate->ac_state.pending_state == 0 &&
			  gate->ac_state.last_state == 0 &&
			  (now_ms - gate->ac_state.last_change_ms) >=
				  gate->ac_state.debounce_ms;

	if (gate->fault_flags != SAFETY_FAULT_NONE || !stable_off) {
		gate->ev_allowed = false;
		return;
	}

	gate->ev_allowed = true;
}

int64_t safety_gate_apply_timestamp(struct safety_gate *gate, int64_t timestamp_ms)
{
	if (!gate) {
		return timestamp_ms;
	}

	if (gate->last_timestamp_ms >= 0 && timestamp_ms < gate->last_timestamp_ms) {
		gate->fault_flags |= SAFETY_FAULT_TIMESTAMP_BACKWARD;
		gate->time_anomaly = true;
		gate->ev_allowed = false;
		return gate->last_timestamp_ms;
	}

	gate->last_timestamp_ms = timestamp_ms;
	return timestamp_ms;
}

void safety_gate_set_queue_overflow(struct safety_gate *gate)
{
	if (!gate) {
		return;
	}

	gate->fault_flags |= SAFETY_FAULT_QUEUE_OVERFLOW;
	gate->ev_allowed = false;
}

bool safety_gate_is_ev_allowed(const struct safety_gate *gate)
{
	return gate ? gate->ev_allowed : false;
}

bool safety_gate_has_fault(const struct safety_gate *gate, uint32_t flag)
{
	return gate ? (gate->fault_flags & flag) != 0 : false;
}

bool safety_gate_time_anomaly(const struct safety_gate *gate)
{
	return gate ? gate->time_anomaly : false;
}
```

## src/sidewalk_msg.c
```c
/*
 * Sidewalk message helper
 */
#include "sidewalk_msg.h"

#include "sidewalk.h"

#include <sid_hal_memory_ifc.h>
#include <zephyr/logging/log.h>
#include <errno.h>
#include <string.h>

LOG_MODULE_REGISTER(sidewalk_msg, CONFIG_SIDEWALK_LOG_LEVEL);

static void sidewalk_msg_free_ctx(void *ctx)
{
	sidewalk_msg_t *msg = (sidewalk_msg_t *)ctx;
	if (!msg) {
		return;
	}
	if (msg->msg.data) {
		sid_hal_free(msg->msg.data);
	}
	sid_hal_free(msg);
}

int sidewalk_send_msg_copy(const struct sid_msg_desc *desc, const void *payload, size_t len)
{
	if (!desc || !payload || len == 0) {
		return -EINVAL;
	}

	sidewalk_msg_t *msg = sid_hal_malloc(sizeof(*msg));
	if (!msg) {
		LOG_ERR("Failed to alloc msg context");
		return -ENOMEM;
	}
	memset(msg, 0x0, sizeof(*msg));

	msg->msg.size = len;
	msg->msg.data = sid_hal_malloc(msg->msg.size);
	if (!msg->msg.data) {
		LOG_ERR("Failed to alloc msg data");
		sid_hal_free(msg);
		return -ENOMEM;
	}
	memcpy(msg->msg.data, payload, msg->msg.size);
	msg->desc = *desc;

	int err = sidewalk_event_send(sidewalk_event_send_msg, msg, sidewalk_msg_free_ctx);
	if (err) {
		sidewalk_msg_free_ctx(msg);
	}
	return err;
}

int sidewalk_send_notify_json(const char *json, size_t len)
{
	struct sid_msg_desc desc = {
		.type = SID_MSG_TYPE_NOTIFY,
		.link_type = SID_LINK_TYPE_ANY,
		.link_mode = SID_LINK_MODE_CLOUD,
	};

	return sidewalk_send_msg_copy(&desc, json, len);
}
```

## src/sidewalk_msg.h
```c
/*
 * Sidewalk message helper
 */
#ifndef SIDEWALK_MSG_H
#define SIDEWALK_MSG_H

#include <stddef.h>

#include <sid_api.h>

int sidewalk_send_notify_json(const char *json, size_t len);
int sidewalk_send_msg_copy(const struct sid_msg_desc *desc, const void *payload, size_t len);

#endif /* SIDEWALK_MSG_H */
```

## src/time_sync.c
```c
/*
 * Simple epoch time sync helper
 */
#include "time_sync.h"

static int64_t epoch_at_boot_ms;
static bool time_synced;
static int64_t last_timestamp_ms;
static bool time_anomaly;

void time_sync_init(void)
{
	epoch_at_boot_ms = 0;
	time_synced = false;
	last_timestamp_ms = -1;
	time_anomaly = false;
}

void time_sync_apply_epoch_ms(int64_t epoch_ms, int64_t uptime_ms)
{
	if (last_timestamp_ms >= 0 && epoch_ms < last_timestamp_ms) {
		time_anomaly = true;
		epoch_at_boot_ms = last_timestamp_ms - uptime_ms;
	} else {
		epoch_at_boot_ms = epoch_ms - uptime_ms;
	}
	time_synced = true;
}

int64_t time_sync_get_timestamp_ms(int64_t uptime_ms)
{
	int64_t ts_ms = time_synced ? (epoch_at_boot_ms + uptime_ms) : uptime_ms;

	if (last_timestamp_ms >= 0 && ts_ms < last_timestamp_ms) {
		time_anomaly = true;
		if (time_synced) {
			epoch_at_boot_ms = last_timestamp_ms - uptime_ms;
		}
		ts_ms = last_timestamp_ms;
	}

	last_timestamp_ms = ts_ms;
	return ts_ms;
}

bool time_sync_is_synced(void)
{
	return time_synced;
}

bool time_sync_time_anomaly(void)
{
	return time_anomaly;
}
```
