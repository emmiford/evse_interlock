/*
 * GPIO input alias for RAK4631.
 */

/ {
	gpio_keys {
		compatible = "gpio-keys";
		extinput0: extinput0 {
			gpios = <&gpio0 11 (GPIO_PULL_UP | GPIO_ACTIVE_LOW)>;
			label = "External Input 0";
		};
	};

	aliases {
		extinput0 = &extinput0;
	};
};
